/dts-v1/;

#include "rk3588-ks-t1.dtsi"
#include "rk3588-ks-t1-imx415.dtsi"
#include "rk3588-ks-t1-audio.dtsi"
#include "rk3588-ks-t1-net.dtsi"
#include "rk3588-linux.dtsi"

/ {
	model = "Rockchip RK3588-EVB-KS-T1 LP4 V10 Board";
	compatible = "rockchip,rk3588-evb7-lp4-v10", "rockchip,rk3588";
};