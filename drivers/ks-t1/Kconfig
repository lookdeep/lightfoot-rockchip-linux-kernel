## drivers/ks-t1/Kconfig
```kconfig
menu "KS-T1 drivers"

config ALSA_UPCM
	tristate "ALSA UPCM driver"
	depends on ARCH_ROCKCHIP
	select SWITCH
	default m
	help
	  Build the upcm driver for the KS-T1 board

endmenu
```
